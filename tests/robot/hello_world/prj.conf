## prj.conf
```kconfig
CONFIG_REBOOT=y
CONFIG_SHELL=y
```

## src/main.c
```c
/*
 * Copyright (c) 2020 Stephanos Ioannidis <root@stephanos.io>
 *
 * SPDX-License-Identifier: Apache-2.0
 */

#include <stdio.h>

int main(void)
{
	printf("Hello World to Robot-Framework!\n");
	return 0;
}
```
