## boards/arm/mps4/Kconfig.defconfig
```kconfig
# Copyright 2025 Arm Limited and/or its affiliates <open-source-office@arm.com>
# SPDX-License-Identifier: Apache-2.0

if BOARD_MPS4_CORSTONE315_FVP || \
	BOARD_MPS4_CORSTONE315_FVP_NS || \
	BOARD_MPS4_CORSTONE320_FVP  || \
	BOARD_MPS4_CORSTONE320_FVP_NS

# Get flash configuration for NS image from dts flash partition
config USE_DT_CODE_PARTITION
	default y if TRUSTED_EXECUTION_NONSECURE

# By default, if we build for a Non-Secure version of the board,
# force building with TF-M as the Secure Execution Environment.
config BUILD_WITH_TFM
	default y if TRUSTED_EXECUTION_NONSECURE

if SERIAL

config UART_INTERRUPT_DRIVEN
	default y

endif # SERIAL

if ROMSTART_RELOCATION_ROM && (BOARD_MPS4_CORSTONE315_FVP || BOARD_MPS4_CORSTONE320_FVP)

config ROMSTART_REGION_ADDRESS
	default $(dt_nodelabel_reg_addr_hex,itcm)

config ROMSTART_REGION_SIZE
	default $(dt_nodelabel_reg_size_hex,itcm,0,k)

endif

endif
```

## boards/riscv/bl604e_iot_dvk/Kconfig.board
```kconfig
# Copyright (c) 2022 ATL Electronics
# SPDX-License-Identifier: Apache-2.0

config BOARD_BL604E_IOT_DVK
	bool "BL604E IOT DVK development board"
	depends on SOC_PART_NUMBER_BL604E20Q2I
```

## boards/riscv/bl604e_iot_dvk/Kconfig.defconfig
```kconfig
# Copyright (c) 2022 ATL Electronics
# SPDX-License-Identifier: Apache-2.0

if BOARD_BL604E_IOT_DVK

config BOARD
	default "bl604e_iot_dvk"

endif   # BOARD_BL604E_IOT_DVK
```

## boards/riscv/bl604e_iot_dvk/bl604e_iot_dvk_defconfig
```kconfig
# Copyright (c) 2022, ATL Electronics
# SPDX-License-Identifier: Apache-2.0

CONFIG_SOC_SERIES_BL6=y
CONFIG_SOC_PART_NUMBER_BL604E20Q2I=y
CONFIG_BOARD_BL604E_IOT_DVK=y

CONFIG_CONSOLE=y
CONFIG_UART_CONSOLE=y
CONFIG_SERIAL=y
CONFIG_UART_BFLB=y
```

## soc/riscv/bouffalolab/bflb/Kconfig.soc.bl6
```kconfig
# Copyright (c) 2021, ATL Electronics
# SPDX-License-Identifier: Apache-2.0

choice
	prompt "bouffalo Lab BL6 MCU Selection"
	depends on SOC_SERIES_BL6

	config SOC_PART_NUMBER_BL602C00Q2I
		bool "BL602C00Q2I"
		select RISCV_ISA_RV32I
		select RISCV_ISA_EXT_M
		select RISCV_ISA_EXT_A
		select RISCV_ISA_EXT_C
		select RISCV_ISA_EXT_ZICSR
		select RISCV_ISA_EXT_ZIFENCEI

	config SOC_PART_NUMBER_BL602C20Q2I
		bool "BL602C20Q2I"
		select RISCV_ISA_RV32I
		select RISCV_ISA_EXT_M
		select RISCV_ISA_EXT_A
		select RISCV_ISA_EXT_C
		select RISCV_ISA_EXT_ZICSR
		select RISCV_ISA_EXT_ZIFENCEI

	config SOC_PART_NUMBER_BL604E20Q2I
		bool "BL604E20Q2I"
		select RISCV_ISA_RV32I
		select RISCV_ISA_EXT_M
		select RISCV_ISA_EXT_A
		select RISCV_ISA_EXT_C
		select RISCV_ISA_EXT_ZICSR
		select RISCV_ISA_EXT_ZIFENCEI

endchoice
```

## tests/application_development/cpp/cpp_compile/testcase.yaml
```yaml
tests:
  application_development.cpp.main:
    platform_exclude: qemu_x86_coverage native_posix
    tags: cpp
    extra_configs:
      - CONFIG_MINIMAL_LIBC_MALLOC_ARENA_SIZE=128
  application_development.cpp.main.libcxx:
    platform_allow: native_posix
    tags: cpp
    extra_configs:
      - CONFIG_LIB_CPLUSPLUS=y
```

## tests/application_development/cpp/static_vars/testcase.yaml
```yaml
tests:
  misc.app_dev.cpp.static_vars:
    platform_exclude: qemu_x86_coverage native_posix
    toolchain_exclude: xcc
    tags: cpp
  misc.app_dev.cpp.static_vars.libcxx:
    platform_exclude: qemu_x86_coverage
    toolchain_exclude: xcc
    tags: cpp
    extra_configs:
        - CONFIG_LIB_CPLUSPLUS=y
```

## tests/robot/hello_world/testcase.yaml
```yaml
common:
  tags:
    - drivers
    - shell
    - uart
  platform_allow:
#    - nucleo_h753zi
    - nucleo_u5a5zj_q
  harness: robot

tests:
  robot.shell:
    harness_config:
      robot_type: robot-framework
      robot_testsuite: hello_world.robot
  robot.shell.serial:
    harness_config:
      robot_type: robot-framework
      robot_testsuite: hello_world_serial.robot
```
